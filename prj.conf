## CMakeLists.txt
```
# SPDX-License-Identifier: Apache-2.0

cmake_minimum_required(VERSION 3.20.0)
find_package(Zephyr REQUIRED HINTS $ENV{ZEPHYR_BASE})
project(FogML-Zephyr)

set(fogml_sources
    src/fogml_sdk/anomaly/fogml_anomaly.c
    src/fogml_sdk/anomaly_rt/fogml_lof.c
    src/fogml_sdk/anomaly_rt/fogml_reservoir.c
    src/fogml_sdk/ports/fogml_ports_zephyr.c
    src/fogml_sdk/dsp/fogml_dsp.c
    src/fogml_sdk/scaler/fogml_scaler.c
)

file(GLOB fogml_generated CONFIGURE_DEPENDS
     "src/fogml_generated/*.h"
     "src/fogml_generated/*.c"
)

set(private_sources
    src/main.c)

target_sources(app PRIVATE ${private_sources} ${fogml_sources} ${fogml_generated})
```

## prj.conf
```kconfig
CONFIG_GPIO=y
CONFIG_NEWLIB_LIBC=y
CONFIG_CBPRINTF_FP_SUPPORT=y

CONFIG_ENTROPY_GENERATOR=y
CONFIG_TEST_RANDOM_GENERATOR=y

CONFIG_SPI=y

# Peripherals
CONFIG_SENSOR=y
CONFIG_ADXL362=y
CONFIG_ADXL362_ACCEL_RANGE_2G=y
CONFIG_ADXL362_ACCEL_ODR_RUNTIME=y
CONFIG_ADXL362_ABS_REF_MODE=1
CONFIG_ADXL362_INTERRUPT_MODE=1
CONFIG_ADXL362_TRIGGER_GLOBAL_THREAD=y
```

## src/main.c
```c
/*
   Copyright 2021 FogML
   Licensed under the Apache License, Version 2.0 (the "License");
   you may not use this file except in compliance with the License.
   You may obtain a copy of the License at
       http://www.apache.org/licenses/LICENSE-2.0
   Unless required by applicable law or agreed to in writing, software
   distributed under the License is distributed on an "AS IS" BASIS,
   WITHOUT WARRANTIES OR CONDITIONS OF ANY KIND, either express or implied.
   See the License for the specific language governing permissions and
   limitations under the License.
*/

#include <zephyr.h>
#include <stdio.h>
#include <device.h>
#include <devicetree.h>
#include <drivers/gpio.h>
#include <drivers/sensor.h>
#include "fogml_config.h"

//#define DATA_LOGGER

float my_time_series[ACC_TIME_TICKS * ACC_AXIS];
int ticks_stored;

/* 1000 msec = 1 sec */
#define SLEEP_TIME_MS 1000

#define LED_NODE(n) DT_ALIAS(led##n)
#define LED_LABEL(n) DT_GPIO_LABEL(LED_NODE(n), gpios)
#define LED_PIN(n) DT_GPIO_PIN(LED_NODE(n), gpios)
#define LED_FLAGS(n) (GPIO_OUTPUT_INACTIVE | DT_GPIO_FLAGS(LED_NODE(n), gpios))
#define LED_DEV(n) DEVICE_DT_GET(DT_GPIO_CTLR(LED_NODE(n), gpios))

int64_t time_previous;
int64_t time_next;

#if !DT_HAS_COMPAT_STATUS_OKAY(adi_adxl362)
#error "No ADXL362!"
#endif

void led_init()
{
    const struct device *dev;

    dev = device_get_binding(LED_LABEL(0));
    if (dev != NULL)
    {
        gpio_pin_configure(dev, LED_PIN(0), GPIO_OUTPUT_ACTIVE | LED_FLAGS(0));
    }

    dev = device_get_binding(LED_LABEL(1));
    if (dev != NULL)
    {
        gpio_pin_configure(dev, LED_PIN(1), GPIO_OUTPUT_ACTIVE | LED_FLAGS(1));
    }

    dev = device_get_binding(LED_LABEL(2));
    if (dev != NULL)
    {
        gpio_pin_configure(dev, LED_PIN(2), GPIO_OUTPUT_ACTIVE | LED_FLAGS(2));
    }
}

void led_set_0(bool val)
{
    if (device_is_ready(LED_DEV(0)))
    {
        gpio_pin_set(LED_DEV(0), LED_PIN(0), val);
    }
}

void led_set_1(bool val)
{
    if (device_is_ready(LED_DEV(1)))
    {
        gpio_pin_set(LED_DEV(1), LED_PIN(1), val);
    }
}

void led_set_2(bool val)
{
    if (device_is_ready(LED_DEV(2)))
    {
        gpio_pin_set(LED_DEV(2), LED_PIN(2), val);
    }
}

void led_value(int v)
{
    led_set_0(v >> 0 & 1);
    led_set_1(v >> 1 & 1);
    led_set_2(v >> 2 & 1);
}

void main(void)
{
    struct sensor_value accel[3];

    const struct device *dev_acc = device_get_binding(DT_LABEL(DT_INST(0, adi_adxl362)));
    if (dev_acc == NULL)
    {
        printf("ACC device binding problem!\n");
        return;
    }

    led_init();

    time_previous = k_uptime_get();
    ticks_stored = 0;

    while (1)
    {
        time_next = time_previous + 1000 / FOGML_HZ;
        time_previous = k_uptime_get();

        if (time_next > time_previous)
        {
            k_msleep(time_next - time_previous);
        }

        if (sensor_sample_fetch(dev_acc) < 0)
        {
            printf("Sample fetch error!\n");
            return;
        }

        if (sensor_channel_get(dev_acc, SENSOR_CHAN_ACCEL_XYZ, &accel[0]) < 0)
        {
            printf("Channel get error!\n");
            return;
        }

        my_time_series[ticks_stored * ACC_AXIS + 0] = sensor_value_to_double(&accel[0]);
        my_time_series[ticks_stored * ACC_AXIS + 1] = sensor_value_to_double(&accel[1]);
        my_time_series[ticks_stored * ACC_AXIS + 2] = sensor_value_to_double(&accel[2]);

        ticks_stored++;

        if (ticks_stored == ACC_TIME_TICKS)
        {

#ifdef DATA_LOGGER
            fogml_features_logger(my_time_series);
#else
            float score = fogml_anomaly_detector(my_time_series);
            int cl = fogml_classification(my_time_series);
            led_value(cl + 1);
#endif
            ticks_stored = 0;
        }
    }
}
```

## src/fogml_config.h
```c
/*
   Copyright 2021 FogML

   Licensed under the Apache License, Version 2.0 (the "License");
   you may not use this file except in compliance with the License.
   You may obtain a copy of the License at

       http://www.apache.org/licenses/LICENSE-2.0

   Unless required by applicable law or agreed to in writing, software
   distributed under the License is distributed on an "AS IS" BASIS,
   WITHOUT WARRANTIES OR CONDITIONS OF ANY KIND, either express or implied.
   See the License for the specific language governing permissions and
   limitations under the License.
*/

#ifndef FOGML_CONFIG_H
#define FOGML_CONFIG_H

#include "fogml_sdk/fogml.h"

#define FOGML_VERBOSE

//LEARNING
#define LEARNING_SAMPLES  16

// DATA ACQUISITION
// accelerometer data X, Y, Z
#define ACC_TIME_TICKS  20
#define ACC_AXIS  3
#define FOGML_HZ 10


// DIGITAL SIGNAL PROCESSING
// number of features - depends on the DSP blocks
#define FOGML_VECTOR_SIZE ((TINYML_DSP_BASE_LEN + TINYML_DSP_ENERGY_LEN + TINYML_DSP_CROSSINGS_LEN) * ACC_AXIS)

//BLOCK 1 - BASE
tinyml_block_base_config_t block1_config;
tinyml_dsp_block_t block1 = {
    .type = TINYML_DSP_BASE,
    .config = &block1_config

};

//BLOCK 2 - ENERGY
tinyml_block_energy_config_t block2_config;
tinyml_dsp_block_t block2 = {
    .type = TINYML_DSP_ENERGY,
    .config = &block2_config
};

//BLOCK 3 - CROSSINGS
tinyml_block_crossings_config_t block3_config = {
    .threshold = 0.00001
};
tinyml_dsp_block_t block3 = {
    .type = TINYML_DSP_CROSSINGS,
    .config = &block3_config
};

//DSP config
tinyml_dsp_block_t *blocks_tab[] = {&block1, &block2, &block3};

tinyml_dsp_config_t my_dsp_config = {
    .time_ticks = ACC_TIME_TICKS,
    .axis_n = 3,
    .blocks_num = 3,
    .blocks = blocks_tab
};

// RESERVOIR SAMPLING
#define MY_RESERVOIR_SIZE  100
float my_reservoir[MY_RESERVOIR_SIZE * FOGML_VECTOR_SIZE];

tinyml_reservoir_sampling_config_t my_rs_config = {
  .n = MY_RESERVOIR_SIZE,
  .k = 0,
  .vector_size = FOGML_VECTOR_SIZE,
  .reservoir = my_reservoir
};


// LOCAL OUTLINER FACTOR
float my_kdistance[MY_RESERVOIR_SIZE];
float my_lrd[MY_RESERVOIR_SIZE];

tinyml_lof_config_t my_lof_config = {
  .parameter_k = 3,  //k nearest neighbours are considered
  .k_distance = my_kdistance,  //table of k-distance for each of n points
  .lrd = my_lrd, //Local Reachability Density for each of n points
  .n = MY_RESERVOIR_SIZE, //number of points in data
  .vector_size = FOGML_VECTOR_SIZE, //dimension of each points
  .data = my_reservoir //set of points
};

//PIPELINES
void fogml_learning(float *time_series_data) {
#ifdef FOGML_VERBOSE
    fogml_printf("Updating reservoir.");
#endif

    float *vector = (float*)malloc(sizeof(float) * FOGML_VECTOR_SIZE);
    
    tinyml_dsp(time_series_data, vector, &my_dsp_config);

    tinyml_reservoir_sampling(vector, &my_rs_config);

#ifdef FOGML_VERBOSE
    //tinyml_reservoir_verbose(&my_rs_config);
    for(int i = 0; i < FOGML_VECTOR_SIZE; i++) {
        fogml_printf_float(vector[i]);
        fogml_printf(" ");
    }
    fogml_printf("\n");
#endif

    tinyml_lof_learn(&my_lof_config);
    
    free(vector);
}


void fogml_processing(float *time_series_data, float *score) {
    float *vector = (float*)malloc(sizeof(float) * FOGML_VECTOR_SIZE);
    tinyml_dsp(time_series_data, vector, &my_dsp_config);

#ifdef FOGML_VERBOSE
    for(int i = 0; i < FOGML_VECTOR_SIZE; i++) {
        fogml_printf_float(vector[i]);
        fogml_printf(" ");
    }
    fogml_printf("\n");
#endif

    *score = tinyml_lof_score(vector, &my_lof_config);

#ifdef FOGML_VERBOSE
    fogml_printf("LOF Score = ");
    fogml_printf_float(*score);
    fogml_printf("\n");
#endif

    free(vector);
} 

int fogml_classification(float *time_series_data) {
    float *vector = (float*)malloc(sizeof(float) * FOGML_VECTOR_SIZE);
    tinyml_dsp(time_series_data, vector, &my_dsp_config);
    int cl;

    cl = classifier(vector);

#ifdef FOGML_VERBOSE
    fogml_printf("Detected  class = ");
    fogml_printf_int(cl);
    fogml_printf("\n");
#endif

    free(vector);

    return cl;
} 


extern fogml_anomaly_config_t kmeans_anomaly_config;
extern fogml_min_max_scaler_config_t min_max_scaler_config;

float fogml_anomaly_detector(float *time_series_data) {
    float *vector = (float*)malloc(sizeof(float) * FOGML_VECTOR_SIZE);
    tinyml_dsp(time_series_data, vector, &my_dsp_config);
    float anomaly_sc;

    min_max_scaler(vector, &min_max_scaler_config);

    anomaly_sc = anomaly_score(vector, &kmeans_anomaly_config);

#ifdef FOGML_VERBOSE
    fogml_printf("Anomaly score = ");
    fogml_printf_float(anomaly_sc);
    fogml_printf("\n");
#endif

    free(vector);

    return anomaly_sc;
} 

void fogml_features_logger(float *time_series_data) {
    float *vector = (float*)malloc(sizeof(float) * FOGML_VECTOR_SIZE);
    tinyml_dsp(time_series_data, vector, &my_dsp_config);

    for(int i = 0; i < FOGML_VECTOR_SIZE; i++) {
        fogml_printf_float(vector[i]);
        
        if (i < FOGML_VECTOR_SIZE - 1) {
            fogml_printf(" ");
        }
        
    }
    fogml_printf("\n");

    free(vector);
}

#endif
```
